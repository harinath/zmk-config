## config/west.yml
```yaml
manifest:
  defaults:
    revision: v0.3 # Also change .github/workflows/build.yml

  remotes:
    - name: urob
      url-base: https://github.com/urob

    - name: zmkfirmware
      url-base: https://github.com/zmkfirmware

    - name: englmaxi
      url-base: https://github.com/englmaxi

  projects:
    - name: zmk
      remote: zmkfirmware
      import: app/west.yml

    - name: zmk-helpers
      remote: urob
      path: modules/zmk/helpers

    - name: zmk-dongle-display
      remote: englmaxi
      #revision: main # use 'v0.3' instead of 'main' if you use have pinned zmk to 'v0.3' or below      

  self:
    path: config
```
